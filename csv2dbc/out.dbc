VERSION ""

NS_ :

BS_:

BU_: node1 node3

BO_ 77 ABSdata: 6 Vector__XXX
 SG_ AccelerationForce : 10|16@1+ (1,0) [0|0] "" Vector__XXX
 SG_ Diagnostics : 0|1@1+ (1,0) [0|0] "" Vector__XXX

BO_ 787 ABSdata2: 6 Vector__XXX
 SG_ Accelera323243tionForce : 32|16@1+ (1,0) [0|0] "" Vector__XXX

BO_ 454 ABSdata3: 6 Vector__XXX
 SG_ Diag432432nostics : 16|8@1+ (1,0) [0|0] "" Vector__XXX
